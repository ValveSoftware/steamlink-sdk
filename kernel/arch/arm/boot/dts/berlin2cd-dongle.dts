/*
 * MARVELL BERLIN2CT Dongle board device tree source
 *
 * Copyright (c) 2013 Marvell International Ltd.
 *		http://www.marvell.com
 *
 * This program is free software; you can redistribute it and/or modify
 * it under the terms of the GNU General Public License version 2 as
 * published by the Free Software Foundation.
*/

/dts-v1/;
/include/ "berlin2cd.dtsi"

/ {
	model = "MARVELL BG2CD Dongle board based on BERLIN2CD";
	compatible = "marvell,berlin2cd-dongle", "marvell,berlin2cd";

	soc {
		usb@F7ED0000 {
			status = "disable";
		};
	};
};
