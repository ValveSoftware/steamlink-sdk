## kernel/arch/arm/mach-berlin/Kconfig
```kconfig
if ARCH_BERLIN

menu "Marvell Berlin SoCs Support"

choice
	prompt "Select Berlin SoC family for target system"

config ARCH_BERLIN2
	bool "BG2"
	select USB_ARCH_HAS_EHCI if USB_SUPPORT
	help
	  Support for Marvell Berlin Generation 2 SoCs, based on the
	  ARM CortexA9 CPU and the ARM PL310 L2 cache controller
endchoice

choice
	prompt "Choose SoCs"
	default BERLIN2CT
	depends on ARCH_BERLIN2
	help
	  This option allows to select a SoC version.

config BERLIN2CD
	bool "BG2 CD"
	help
	  BG2 CD version

endchoice

comment "BERLIN modules"

config BERLIN_SHM
	tristate "Support Shared Memory(SHM)"
	default y
	help
	  This module implements the shared memory access.

config BERLIN_CC
	tristate "Support Common Communication(CC)"
	default y
	help
	  This module implements the interprocess communication scheme
	  for Marvell Berlin SoCs

config BERLIN_GPIO
	tristate "Support GPIO port operations from user space"
	default n
	help
	  Enable support for GPIO control from user space

config BERLIN_I2C
	tristate "Support I2C bus"
	default y
	help
	  Enable support fo I2C bus in Berlin SoC

config BERLIN_GPU
        tristate "SoC's 2d GPU support"
        default m
        help
          2D GPU support

config BERLIN_GPU3D
        tristate "SoC's 3d GPU support"
        default m
        help
          3D GPU support

config BERLIN_PE
        tristate "Support Presentation Engine"
        default m
        help
          Enable support for Presentation Engine

config BERLIN_PXA3XX_NFC
	tristate "Support NAND Flash Controller (fork of pxa3xx_nand)"
	default n
	help
	  A fork of mainline pxa3xx_nand.c. This NFC has no dedicated interrupt, but SoC
	  contains a powerfull pbridge DMA engine whose interrupt can be enabled/disabled.
	  So the driver could work in 3 modes: nonDMA, polling-DMA, interrupt-DMA.

config BERLIN_NAND_RANDOMIZER
	bool "Support software NAND randomizer"
	default n
	depends on BERLIN_PXA3XX_NFC
	help
	  To improve data stability for some large-capacity MLC(multipil-level cell) chips,
	  data have to be randomized before storing into, or
	  derandomized after reading out, from the physical cells.
	  For chips that don't build in HW randomizer, SW randomizer is needed.
	  Say Y here if you have no idea

config BERLIN_NAND_READ_RETRY
	bool "Support NAND read retry when ecc fail in read operation"
	default y
	depends on BERLIN_PXA3XX_NFC
	help
	  To improve nand read ability of error correction. When ecc fail in read operation,
	  change the read cmd parameter of nand chip. Every kind of Nand chip's READ RETRY feature
	  diff from each other. If nand chip do not support READ RETRY, this feature will do nothing.
	  Now support only hynix nand chip read retry.

config BERLIN_SDIO_WLAN_8787
	tristate "SDIO Wlan (IEEE802.11 A|B|G|N) driver for wlan8787 module"
	default n
	depends on MMC_SDHCI_MV
	select WIRELESS_EXT
	select WEXT_PRIV
	select WEXT_SPY
	help
	  This is the wifi module for Berlin. Please try build it for module only.

config BERLIN_SDIO_WLAN_8797
	tristate "SDIO Wlan (IEEE802.11 A|B|G|N) driver for wlan8797 module"
	default n
	depends on MMC_SDHCI_MV
	select WIRELESS_EXT
	select WEXT_PRIV
	select WEXT_SPY
	help
	  This is the wifi module for Berlin. Please try build it for module only.

config BERLIN_SDIO_WLAN_8801
	tristate "SDIO Wlan (IEEE802.11 A|B|G|N) driver for wlan8801 module"
	default n
	depends on MMC_SDHCI_MV
	select WIRELESS_EXT
	select WEXT_PRIV
	select WEXT_SPY
	help
	  This is the wifi module for Berlin. Please try build it for module only.

config BERLIN_SDIO_WLAN_8897
	tristate "SDIO Wlan (IEEE802.11 A|B|G|N) driver for wlan8897 module"
	default n
	depends on MMC_SDHCI_MV
	select WIRELESS_EXT
	select WEXT_PRIV
	select WEXT_SPY
	help
	  This is the wifi module for Berlin. Please try build it for module only.

config BERLIN_SDIO_BT_8897
	tristate "SDIO Bluetooth driver for SD8897 module"
	default n
	help
	  This is the bt module for Berlin. Please try build it for module only.

config BERLIN_SDIO_BT_8897_CHAR_DRV
	tristate "SDIO Bluetooth character device driver for SD8897 module"
	default n
	help
	  This is the bt module for Berlin for bluedroid stack. Please try build it for module only.

config BERLIN_FASTLOGO
	tristate "Support fast logo"
	default n
	help
	  Enable support for fast logo

config BERLIN_STREAMBOX_RESET
	tristate "Use Streambox reset method"
	default n
	help
	  Enable support for streambox way of reset

config BERLIN_STEAMLINK_LOW_POWER
	tristate "Use Steamlink low power enter / exit"
	default n
	help
	  Enable support for steamlink low power enter / exit code.  When in low power, clocks are gated / slowed.  Low power can be entered using a sysfs file.  Lowpower can be exited by using sysfs, or automatically when there is activity on usb (ie remote wakeup)

endmenu

endif
```

## kernel/fs/unionfs/Kconfig
```kconfig
config UNION_FS
	tristate "Union file system (EXPERIMENTAL)"
	depends on EXPERIMENTAL
	help
	  Unionfs is a stackable unification file system, which appears to
	  merge the contents of several directories (branches), while keeping
	  their physical content separate.

	  See <http://unionfs.filesystems.org> for details

config UNION_FS_XATTR
	bool "Unionfs extended attributes"
	depends on UNION_FS
	help
	  Extended attributes are name:value pairs associated with inodes by
	  the kernel or by users (see the attr(5) manual page).

	  If unsure, say N.

config UNION_FS_DEBUG
	bool "Debug Unionfs"
	depends on UNION_FS
	help
	  If you say Y here, you can turn on debugging output from Unionfs.
```
